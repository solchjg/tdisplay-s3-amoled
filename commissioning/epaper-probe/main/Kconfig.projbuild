## commissioning/epaper-probe/main/Kconfig.projbuild
```kconfig
menu "E-paper probe"

config PROBE_SDA
    int "Qwiic bus SDA GPIO (a header pin)"
    default 8
    range 0 48

config PROBE_SCL
    int "Qwiic bus SCL GPIO (a header pin)"
    default 9
    range 0 48

config PROBE_SPI_HZ
    int "Panel SPI clock in Hz"
    default 4000000
    range 1000000 20000000

config PROBE_PARTIALS
    int "Partial refreshes to time after the full one"
    default 5
    range 0 50

config PROBE_SLEEP_S
    int "Deep sleep between runs in seconds (0: stay awake)"
    default 60
    range 0 86400
    help
        Before sleeping the probe puts the panel in deep sleep and cuts its
        supply (GPIO 7 low, held), so the last screen stays visible at zero
        panel power. Measure the board's sleep current from the battery
        connector with USB unplugged.

endmenu
```

## commissioning/feathers3-probe/main/Kconfig.projbuild
```kconfig
menu "FeatherS3D probe"

config PROBE_LDO2_HOLD_S
    int "Seconds LDO2 stays off, then on, for the meter on the vertical socket's 3V3"
    default 10
    range 0 60

config PROBE_KEY_S
    int "Seconds to watch the user key on GPIO 1 (0: skip)"
    default 10
    range 0 60

config PROBE_WALK_S
    int "Seconds each header pin toggles in the pin walk (0: no walk)"
    default 8
    range 0 30

config PROBE_SLEEP_S
    int "Seconds of deep sleep for the current measurement (0: no sleep)"
    default 60
    range 0 600

endmenu
```

## commissioning/lora-survey/main/Kconfig.projbuild
```kconfig
menu "LoRa survey"

config SURVEY_DEV_EUI
    string "DevEUI, 16 hex digits (from the network's console)"
    default ""

config SURVEY_JOIN_EUI
    string "JoinEUI (AppEUI), 16 hex digits"
    default "0000000000000000"

config SURVEY_APP_KEY
    string "AppKey, 32 hex digits"
    default ""

config SURVEY_NWK_KEY
    string "NwkKey, 32 hex digits; empty for LoRaWAN 1.0.x (Helium, or TTN set to 1.0.x)"
    default ""

config SURVEY_SUBBAND
    int "US915 sub-band (TTN and Helium in the US use 2)"
    range 1 8
    default 2

config SURVEY_TX_DBM
    int "Transmit power in dBm"
    range 2 22
    default 20
    help
        The SX1262's output. 20 dBm is a fair stand-in for a field device;
        a lower value shows how much margin a weaker radio would keep.

choice SURVEY_MODE
    prompt "What one round sends"
    default SURVEY_MODE_LADDER
    config SURVEY_MODE_LADDER
        bool "Ladder: SF7 first, then SF8, SF9, SF10 until a gateway answers (at most one downlink)"
    config SURVEY_MODE_ALL
        bool "All: one uplink at each of SF7 - SF10 (up to four downlinks; private gateway or Helium)"
endchoice

config SURVEY_EVERY_S
    int "Seconds between automatic rounds (0: only on a key press)"
    range 0 3600
    default 0
    help
        On The Things Network keep a round to a few a day per device in
        normal use: the fair use policy allows 30 s of airtime and 10
        downlinks a day.

endmenu
```

## commissioning/modem-probe/main/Kconfig.projbuild
```kconfig
menu "Modem probe"

config PROBE_APN
    string "APN of the SIM (e.g. iot.1nce.net for 1NCE, hologram for Hologram)"
    default "iot.1nce.net"

choice PROBE_RAT
    prompt "Radio access"
    default PROBE_RAT_CATM
    config PROBE_RAT_CATM
        bool "LTE-M only (AT+CMNB=1)"
    config PROBE_RAT_NB
        bool "NB-IoT only (AT+CMNB=2)"
    config PROBE_RAT_BOTH
        bool "LTE-M and NB-IoT (AT+CMNB=3)"
endchoice

config PROBE_PLMN
    string "Network to lock to, as MCC and MNC (empty: automatic)"
    default ""
    help
        E.g. 310260 T-Mobile, 310410 AT&T, 311480 Verizon. Sent as
        AT+COPS=1,2,"<PLMN>" on a full attach; with it empty a previous lock
        is undone with AT+COPS=0.

config PROBE_PLMN_FALLBACK
    bool "Prefer that network, falling back to automatic choice"
    depends on PROBE_PLMN != ""
    default n
    help
        Sends AT+COPS=4 instead of AT+COPS=1: the modem tries the named
        network first and chooses another itself when it cannot register.

config PROBE_ATTACH_S
    int "Seconds to wait for network registration"
    range 30 600
    default 180

config PROBE_TB_URL
    string "ThingsBoard base URL (empty: no telemetry POST)"
    default ""
    help
        As tb_url of FSD 32.2, e.g. https://tb.example.org. Use a test device:
        every run posts one record.

config PROBE_TB_TOKEN
    string "ThingsBoard device access token"
    default ""
    help
        For a local build only; CI leaves it empty. A settings image flashed
        at 0x9000 (namespace "probe", key "tb_token") overrides it.

config PROBE_NTFY_URL
    string "ntfy server base URL (empty: no alert)"
    default ""

config PROBE_NTFY_TOPIC
    string "ntfy topic"
    default ""
    help
        For a local build only; CI leaves it empty. A settings image flashed
        at 0x9000 (namespace "probe", key "ntfy_topic") overrides it.

config PROBE_NTFY_TOKEN
    string "ntfy access token (empty: none)"
    default ""
    help
        For a local build only; CI leaves it empty. A settings image flashed
        at 0x9000 (namespace "probe", key "ntfy_token") overrides it.

config PROBE_GPS
    bool "Seek one GPS fix on the first run (LTE off meanwhile; needs the GPS antenna)"
    default n

config PROBE_GPS_LIMIT_S
    int "Seconds to wait for the GPS fix"
    depends on PROBE_GPS
    range 60 3600
    default 1200

config PROBE_PSM
    bool "Ask the network for PSM (TAU 1 h, active time 10 s)"
    default n

config PROBE_OLED_SH1106
    bool "The status screen is an SH1106 (most 1.3 inch modules) rather than an SSD1306"
    default n

config PROBE_OLED_SDA
    int "Status screen SDA GPIO (-1: no screen)"
    range -1 48
    default 13

config PROBE_OLED_SCL
    int "Status screen SCL GPIO"
    range 0 48
    default 21

config PROBE_EVERY_MIN
    int "Minutes between runs (0: run once, then print the signal every 30 s)"
    range 0 1440
    default 0
    help
        Above 0 the probe is a soak test: after each run the ESP32-S3 deep-sleeps
        until the next one. Without PSM the modem is powered down between runs,
        so each run is a cold attach.

endmenu
```

## commissioning/notecard-probe/main/Kconfig.projbuild
```kconfig
menu "Notecard probe"

config PROBE_PRODUCT
    string "Notehub ProductUID (empty: leave hub.set and card.transport as they are)"
    default ""
    help
        With a ProductUID the probe sends hub.set (mode periodic, outbound 60,
        inbound 1440) and card.transport cell when the Notecard differs, as
        FR-33.4 and FR-33.14 do.

config PROBE_SYNC
    bool "Force one sync and report its data use (needs a ProductUID)"
    default n

config PROBE_GPS
    bool "Seek a GPS fix (needs the GPS antenna and one completed sync)"
    default n

endmenu
```

## commissioning/sat-probe/main/Kconfig.projbuild
```kconfig
menu "Satellite probe"

config PROBE_PRODUCT
    string "Notehub ProductUID (empty: leave hub.set as it is)"
    default ""
    help
        With a ProductUID the probe sends hub.set (mode periodic, outbound 60,
        inbound 1440) when the Notecard differs, as notecard-probe does.

choice PROBE_TRANSPORT
    prompt "Transport for the trial"
    default PROBE_CELL
    help
        Stage 2 sends the day notes over cellular; stage 3 over Skylo only.
        The templates must have reached Notehub over cellular once before a
        run with ntn: run cell first on the same Notecard.

config PROBE_CELL
    bool "cell (stage 2: any cellular Notecard)"

config PROBE_NTN
    bool "ntn (stage 3: Notecard for Skylo, satellite only)"

endchoice

config PROBE_MINMAX
    bool "Send the 61-byte variant with the day's minimum and maximum"
    default n

config PROBE_OVERSIZE
    bool "Also send one 280-byte note to big.qo (Skylo should drop it)"
    default n

endmenu
```

## commissioning/tsim-probe/main/Kconfig.projbuild
```kconfig
menu "T-SIM7080G probe"

config PROBE_WALK_S
    int "Seconds each header pin toggles in the pin walk (0: no walk)"
    default 4
    range 0 30

config PROBE_SLEEP_S
    int "Seconds of each deep sleep for the current measurement"
    default 60
    range 10 600

config PROBE_OLED
    bool "Draw the test screen on the SSD1322 OLED (FR-35.16)"
    default y
    help
        Harmless without the OLED: the SPI writes go nowhere and the stage
        only waits its 10 s.

endmenu
```

## commissioning/ws-lcd-probe/main/Kconfig.projbuild
```kconfig
menu "Waveshare 1.9in LCD probe"

config PROBE_SPI_MHZ
    int "SPI clock in MHz"
    default 2
    range 1 62
    help
        The ST7789 takes up to 62.5 MHz on short traces; jumper wires on a
        shared bus may need less. Raise it once the pattern is clean.

config PROBE_LANDSCAPE
    bool "Landscape (320 x 170) instead of portrait (170 x 320)"
    default y

config PROBE_PIN_CS
    int "LCD CS GPIO"
    default 3
    help
        3 is the e-paper's CS line (§36), free with the e-paper unplugged;
        19 is the one free header pin when the e-paper stays wired.

config PROBE_PIN_RST
    int "LCD RST GPIO (-1: RST tied to 3V3, software reset)"
    default 20
    range -1 48

config PROBE_PIN_BL
    int "LCD BL GPIO, driven high after start (-1: BL tied to 3V3)"
    default 1
    range -1 48

config PROBE_BLINK
    bool "Only blink every LCD line as a GPIO (3 s high, 3 s low) for a meter"
    default y
    help
        The panel is never started: CS, DC, CLK, DIN, RST and BL all go high
        and low together every 3 s, forever, so each can be checked
        with a meter at the LCD's own connector.

endmenu
```

## commissioning/ws-probe/main/Kconfig.projbuild
```kconfig
menu "Waveshare SIM7670G probe"

config PROBE_APN
    string "APN of the SIM (empty leaves the modem's own)"
    default "hologram"

config PROBE_REGISTER_S
    int "Seconds to wait for the modem to register"
    default 120
    range 10 600

config PROBE_GNSS_S
    int "Seconds of GNSS search (0: none)"
    default 0
    range 0 1800

config PROBE_WALK_S
    int "Seconds each header pin toggles in the pin walk (0: no walk)"
    default 4
    range 0 30

config PROBE_SLEEP_S
    int "Seconds of each deep sleep for the current measurement"
    default 60
    range 10 600

endmenu
```

## components/board/Kconfig
```kconfig
menu "Board"

    choice APP_BOARD
        prompt "Board this build runs on"
        default APP_BOARD_TDISPLAY_S3_AMOLED
        help
            FSD §35 (FR-35.5): one source tree, the board chosen at build time.

        config APP_BOARD_TDISPLAY_S3_AMOLED
            bool "LilyGO T-Display-S3 AMOLED 1.91\""

        config APP_BOARD_WS_SIM7670G
            bool "Waveshare ESP32-S3-SIM7670G-4G (FSD §35)"

    endchoice

    config APP_OLED_STANDIN
        bool "Bench stand-in: the 1.3\" OLED on the sensor bus (never released)"
        depends on APP_BOARD_WS_SIM7670G
        default n
        help
            FSD FR-35.22: draws the six lines on a 128 x 64 SSD1306 or SH1106
            on the sensor bus (address 0x3C) instead of the SSD1322, 21
            characters a line. A bench build until the SSD1322 is fitted;
            never released.

    config APP_OLED_STANDIN_SH1106
        bool "The stand-in is an SH1106 (most 1.3\" modules)"
        depends on APP_OLED_STANDIN
        default y
        help
            Off for an SSD1306.

endmenu
```

## components/setup_check/Kconfig
```kconfig
menu "Setup check"

    config SETUP_CHECK_KEY_GPIO
        int "User key GPIO (active low)"
        default 21
        help
            The key that ends the setup check hold (FSD §24): the board's user
            key, the same that wakes the device from deep sleep.

    config SETUP_CHECK_KEY2_GPIO
        int "Second key GPIO (active low, -1 for none)"
        default -1
        help
            A second key that ends the hold the same way, such as the BOOT
            key next to the LED that blinks during the hold.

    config SETUP_CHECK_NVS_NAMESPACE
        string "NVS namespace of the pending mark"
        default "setup"

endmenu
```

## tests/target/lcd_fault/components/lcd/Kconfig
```kconfig
menu "LCD fault injection (test build only)"

    choice LCD_FAULT_AT
        prompt "Fail at"
        default LCD_FAULT_AT_INIT
        config LCD_FAULT_AT_INIT
            bool "initialisation (lcd_start)"
        config LCD_FAULT_AT_WRITE
            bool "the k-th lcd_draw_line after T1"
    endchoice

    config LCD_FAULT_WRITE_N
        int "k"
        default 5
        depends on LCD_FAULT_AT_WRITE

    config LCD_FAULT_ERR
        hex "esp_err_t returned by the failing call"
        default 0x107

endmenu
```
